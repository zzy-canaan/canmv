## Kconfig
```kconfig
config ENABLE_NETWORK_RT_LAN
    bool "Enable Network RT-Thread Lan(eth)"
    default n

config ENABLE_NETWORK_RT_WLAN
    bool "Enable Network RT-Thread Wlan"
    default y
```
